## buildroot_external_sample/Config.in
```kconfig
source "$BR2_EXTERNAL_BUILDROOT_EXTERNAL_SAMPLE_PATH/package/hello_world/Config.in"
source "$BR2_EXTERNAL_BUILDROOT_EXTERNAL_SAMPLE_PATH/src/driver/dht11/Config.in
source "$BR2_EXTERNAL_BUILDROOT_EXTERNAL_SAMPLE_PATH/src/driver/i2cappClient/Config.in
```
